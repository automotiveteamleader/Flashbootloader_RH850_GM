AUTOSAR XML (schema 3.0.1)
package /MICROSAR
  bsw implementation SysService_WrapperNv_Impl: code-generator=cMICROSAR,GENy, programming-language=C, sw-major-version=1, sw-minor-version=2, sw-patch-version=0, vendor-id=30, ar-major-version=1, ar-minor-version=2, ar-patch-version=0, preconfigured-configuration=SysService_WrapperNv_Pre, recommended-configuration=SysService_WrapperNv_Rec, vendor-specific-module-def=SysService_WrapperNv
  module definition SysService_WrapperNv [0..1]: variants post-build/pre-compile/link-time  # Configuration of the SysService_WrapperNv (ECU State Manager) module.
    container SysService_WrapperNvGeneral  # This container holds the general, pre-compile configuration parameters
      string WrapperNvUserConfigFile: set at pre-compile, origin=Vector Informatik  # Path of User confiuration file to setup specials
      integer WrapperNvBaseAddress: 0..4294967295, set at pre-compile, origin=Vector Informatik
      integer WrapperNvFirstHandle: 0..4294967295, set at pre-compile, origin=Vector Informatik
      string WrapperNvFilePath: set at pre-compile, origin=Vector Informatik
    container WrapperNvDataBlock [0..*]  # Container for which contains parameter for enabling/disabling the availability of APIs.
      string WrapperNvBlockName: set at pre-compile, origin=Vector Informatik
      integer WrapperNvBlockOrder: set at pre-compile, origin=Vector Informatik
      integer WrapperNvBlockCount: set at pre-compile, origin=Vector Informatik
      string WrapperNvBlockDescription: set at pre-compile, origin=Vector Informatik
      boolean WrapperNvBlockGenerate: set at pre-compile, origin=Vector Informatik, default-value=true
      container WrapperNvDataElement [0..*]
        integer WrapperNvDataElementLength: 1.., set at pre-compile, origin=Vector Informatik, default-value=1
        string WrapperNvDataElementName: set at pre-compile, origin=Vector Informatik, default-value=Rename
        string WrapperNvDataElementDefault: set at pre-compile, origin=Vector Informatik
        derived string WrapperNvDataElementDescription: set at pre-compile, origin=Vector Informatik
        boolean WrapperNvDataElementGenerate: set at pre-compile, origin=Vector Informatik, default-value=true
    container VectorCommonData  # This configuration container contains Vector specific vendor data, which are relevant for configuration management purposes.
      string BswmdVersion: set at published-information in variant pre-compile+post-build / pre-compile in variant link-time, origin=Vector Informatik, default-value=1.00.00  # This parameter specifies the version of this bswmd file.
  module config SysService_WrapperNv_Pre: definition=SysService_WrapperNv
  module config SysService_WrapperNv_Rec: definition=SysService_WrapperNv
