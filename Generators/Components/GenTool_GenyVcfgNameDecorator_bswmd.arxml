AUTOSAR XML (schema 4.0)
package /MICROSAR
  module definition GenyBaseEnv
    container GenyBaseEnvGeneral
      string GenyBaseEnvUserConfigFile: origin=Vector Informatik
      integer ProjectType: origin=Vector Informatik  # 0=single; 1=main;2=sub
      integer NumberOfSubProjects: origin=Vector Informatik
  bsw implementation GenyBaseEnv_Impl: programming-language=C, used-code-generator=cMICROSAR, GENy, ar-release-version=4.0.1, vendor-specific-module-def=GenyBaseEnv
