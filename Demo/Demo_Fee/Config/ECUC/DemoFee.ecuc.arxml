AUTOSAR XML (schema 4-2-1)
package /ActiveEcuC
  ecuc value collection ActiveEcuC: ecuc-values=[EcuC, Fee, Fls, Mcu, Dem, NvM]
  module config EcuC: implementation-config-variant=VARIANT-PRE-COMPILE, module-description=EcuC_Impl
    EcucGeneral:
      DummyFunction = false
      DummyStatement = true
      StructAlignment = Auto
      ArrayAlignment = Auto
      StructInArrayAlignment = Auto
      SizeOfEnum = Size32Bit
      SizeOfROMPointer = Size32Bit
      SizeOfRAMPointer = Size32Bit
      DummyStatementKind = SelfAssignment
      CPUType = CPU32Bit
      SizeOfInt = Size32Bit
      ByteOrder = LITTLE_ENDIAN
      BitOrder = LSB_to_MSB
      AtomicBitAccessInBitfield = false
      AtomicVariableAccess = Atomic32BitAccess
      BitFieldDataType = INT
      EcuCSafeBswChecks = false
      ConditionalGenerating = true
      EcucBswImplementationCodeType = EcuCSourceCode
      EcuCUseStdReturnTypeForRte = false
      BswInitialization
        Fee_Init (InitFunction): Header=Fee.h, InitPhase=INIT_TWO_IF, ModuleRef=Fee
  module config Fee: implementation-config-variant=VARIANT-PRE-COMPILE, module-description=Fee_Impl
    FeeSpecificFeatures:
      FeeApplErrorCallbackFunction = Appl_FeeCriticalErrorCallback
      FeeApplErrorCallbackIncludeFile = ApplMain.h
      FeeGetEraseCycleApi = false
      FeeGetWriteCycleApi = false
      FeeUseApplErrorCallback = false
      FeeUseJobCache = false
      FeeForceSectorSwitchApi = false
      FeeDataConversionApi = false
      FeeFblConfig = false
      FeeMaxLinkTableSize = 4095
      FeeFssControlApi = false
    FeeBlockDescriptor (FeeBlockConfiguration):
      FeeBlockNumber = 1
      FeeBlockSize = 1
      FeeImmediateData = false
      FeeNumberOfWriteCycles = 10000
      FeeNumberOfChunkInstances = 1
      FeeNumberOfDatasets = 1
      FeeBlockIdFixed = false
      FeeBlockId = 0
      FeeBlockIsCritical = false
      FeePartition = FeePartitionConfiguration
    FeeGeneral:
      FeeDevErrorDetect = false
      FeeIndex = 0
      FeeNvmJobEndNotification = NvM_JobEndNotification
      FeeNvmJobErrorNotification = NvM_JobErrorNotification
      FeePollingMode = false
      FeeVersionInfoApi = false
      FeeInternalBufferSize = 64
      FeeCfgChkParamBlockNumber = true
      FeeMainFunctionPeriod = 0.005
      FeeMainFunctionTriggering = FixedCycleTime
      FeeDevErrorChecks:
        FeeCfgChkStatusUninit = true
        FeeCfgChkBusy = true
        FeeCfgChkImmediateData = true
        FeeCfgChkParamLengthOffset = true
        FeeCfgChkParamMode = true
        FeeCfgChkParamNullPointer = true
        FeeCfgChkParamSectorNumber = true
        FeeCfgDoParamChk = true
        FeeDebugReporting = true
        FeeDetErrorhook = Det_ReportError
        FeeDetIncludeFile = Det.h
    FeePublishedInformation: FeeBlockOverhead=2, FeeMaximumBlockingTime=1, FeePageOverhead=0, FeeChunkHeader=16, FeeChunkLink=8, FeeSectorHeader=8
    FeePartitionConfiguration:
      FeeBssThresholdReserved = 4096
      FeeFssThresholdReserved = 512
      FeeLowerSectorAddress = 0
      FeeLowerSectorSize = 1024
      FeeUpperSectorAddress = 1024
      FeeUpperSectorSize = 1024
      FeeAddressAlignment = 16
      FeeWriteAlignment = 8
      FeePartitionDevice = FlsConfigSet
  module config Fls: implementation-config-variant=VARIANT-PRE-COMPILE, module-description=Fls_Impl
    FlsGeneral:
      FlsDevErrorDetect = false
      FlsAccess = FLS_DATAFLASH_ACCESS
      FlsAcLoadOnJobStart = false
      FlsCancelApi = true
      FlsCompareApi = false
      FlsDriverIndex = 0
      FlsGetJobResultApi = false
      FlsGetStatusApi = false
      FlsSetModeApi = false
      FlsUseInterrupts = false
      FlsVersionInfoApi = false
      FlsVersionCheckExternalModules = true
      FlsCriticalSectionProtection = true
      FlsVirtualBoundaryAddress = 65536
      FlsDeviceName = R7F701323
      FlsBaseAddress = 0
      FlsTotalSize = 64
      FlsTimeoutMonitoring = false
    FlsPublishedInformation:
      FlsAcLocationErase = 0
      FlsAcLocationWrite = 0
      FlsAcSizeErase = 0
      FlsAcSizeWrite = 0
      FlsEraseTime = 0.01
      FlsErasedValue = 4294967295
      FlsExpectedHwId = NULL
      FlsSpecifiedEraseCycles = 125000
      FlsReadTime = 0.00005
      FlsWriteTime = 0.0017
      FlsBlankCheckTime = 0.000213
      FlsSuspendTime = 0.0003
      FlsCancelTime = 0.00005
    FlsConfigSet:
      FlsAcErase = 0
      FlsAcWrite = 0
      FlsCallCycle = 0
      FlsDefaultMode = MEMIF_MODE_SLOW
      FlsMaxReadFastMode = 0
      FlsMaxReadNormalMode = 256
      FlsMaxWriteFastMode = 0
      FlsMaxWriteNormalMode = 4
      FlsMaxEraseNormalMode = 64
      FlsProtection = 0
      FlsDemEventParameterRefs:
        FLS_E_COMPARE_FAILED = DemEventParameter
        FLS_E_ERASE_FAILED = DemEventParameter
        FLS_E_READ_FAILED = DemEventParameter
        FLS_E_WRITE_FAILED = DemEventParameter
        FLS_E_READ_FAILED_DED = DemEventParameter
      FlsSectorList
        FlsSector: FlsSectorIndex=0, FlsSectorOption=FLS_DF_SECTOR, FlsNumberOfSectors=1, FlsPageSize=4, FlsSectorSize=64, FlsSectorStartaddress=0
  module config Mcu: implementation-config-variant=VARIANT-PRE-COMPILE, module-description=Mcu_Impl
    McuModuleConfiguration:
      McuClockSrcFailureNotification = DISABLED
      McuLviDetectionLevel = DETECTION_LEVEL_0
      McuLviResetMask = false
      McuNumberOfMcuModes = 1
      McuRamSectors = 1
      McuCvmOutMaskFbist = false
      McuCvmOutMaskDiag = false
      McuCvmOutputFilter = false
      McuCvmResetEnable = false
      McuEcmErrorSourcesCfg
        McuEcmErrorSource0:
          McuMiNotification = NULL_PTR
          McuNmiNotification = NULL_PTR
          McuEcmErrorMaskableInterrupt = false
          McuEcmErrorNonMaskableInterrupt = false
          McuEcmErrorInternalReset = false
          McuEcmErrorNMIDelayTimer = false
          McuEcmErrorMIDelayTimer = false
          McuEcmErrorOutputMask = true
        McuEcmErrorSource1:
          McuMiNotification = NULL_PTR
          McuNmiNotification = NULL_PTR
          McuEcmErrorMaskableInterrupt = false
          McuEcmErrorNonMaskableInterrupt = false
          McuEcmErrorInternalReset = false
          McuEcmErrorNMIDelayTimer = false
          McuEcmErrorMIDelayTimer = false
          McuEcmErrorOutputMask = true
        McuEcmErrorSource4:
          McuNmiNotification = NULL_PTR
          McuMiNotification = NULL_PTR
          McuEcmErrorMaskableInterrupt = false
          McuEcmErrorNonMaskableInterrupt = false
          McuEcmErrorInternalReset = false
          McuEcmErrorNMIDelayTimer = false
          McuEcmErrorMIDelayTimer = false
          McuEcmErrorOutputMask = true
        McuEcmErrorSource10:
          McuNmiNotification = NULL_PTR
          McuMiNotification = NULL_PTR
          McuEcmErrorMaskableInterrupt = false
          McuEcmErrorNonMaskableInterrupt = false
          McuEcmErrorInternalReset = false
          McuEcmErrorNMIDelayTimer = false
          McuEcmErrorMIDelayTimer = false
          McuEcmErrorOutputMask = true
        McuEcmErrorSource11:
          McuNmiNotification = NULL_PTR
          McuMiNotification = NULL_PTR
          McuEcmErrorMaskableInterrupt = false
          McuEcmErrorNonMaskableInterrupt = false
          McuEcmErrorInternalReset = false
          McuEcmErrorNMIDelayTimer = false
          McuEcmErrorMIDelayTimer = false
          McuEcmErrorOutputMask = true
        McuEcmErrorSource12:
          McuNmiNotification = NULL_PTR
          McuMiNotification = NULL_PTR
          McuEcmErrorMaskableInterrupt = false
          McuEcmErrorNonMaskableInterrupt = false
          McuEcmErrorInternalReset = false
          McuEcmErrorNMIDelayTimer = false
          McuEcmErrorMIDelayTimer = false
          McuEcmErrorOutputMask = true
        McuEcmErrorSource14:
          McuNmiNotification = NULL_PTR
          McuMiNotification = NULL_PTR
          McuEcmErrorMaskableInterrupt = false
          McuEcmErrorNonMaskableInterrupt = false
          McuEcmErrorInternalReset = false
          McuEcmErrorNMIDelayTimer = false
          McuEcmErrorMIDelayTimer = false
          McuEcmErrorOutputMask = true
        McuEcmErrorSource15:
          McuNmiNotification = NULL_PTR
          McuMiNotification = NULL_PTR
          McuEcmErrorMaskableInterrupt = false
          McuEcmErrorNonMaskableInterrupt = false
          McuEcmErrorInternalReset = false
          McuEcmErrorNMIDelayTimer = false
          McuEcmErrorMIDelayTimer = false
          McuEcmErrorOutputMask = true
        McuEcmErrorSource16:
          McuNmiNotification = NULL_PTR
          McuMiNotification = NULL_PTR
          McuEcmErrorMaskableInterrupt = false
          McuEcmErrorNonMaskableInterrupt = false
          McuEcmErrorInternalReset = false
          McuEcmErrorNMIDelayTimer = false
          McuEcmErrorMIDelayTimer = false
          McuEcmErrorOutputMask = true
        McuEcmErrorSource17:
          McuNmiNotification = NULL_PTR
          McuMiNotification = NULL_PTR
          McuEcmErrorMaskableInterrupt = false
          McuEcmErrorNonMaskableInterrupt = false
          McuEcmErrorInternalReset = false
          McuEcmErrorNMIDelayTimer = false
          McuEcmErrorMIDelayTimer = false
          McuEcmErrorOutputMask = true
        McuEcmErrorSource18:
          McuNmiNotification = NULL_PTR
          McuMiNotification = NULL_PTR
          McuEcmErrorMaskableInterrupt = false
          McuEcmErrorNonMaskableInterrupt = false
          McuEcmErrorInternalReset = false
          McuEcmErrorNMIDelayTimer = false
          McuEcmErrorMIDelayTimer = false
          McuEcmErrorOutputMask = true
        McuEcmErrorSource19:
          McuNmiNotification = NULL_PTR
          McuMiNotification = NULL_PTR
          McuEcmErrorMaskableInterrupt = false
          McuEcmErrorNonMaskableInterrupt = false
          McuEcmErrorInternalReset = false
          McuEcmErrorNMIDelayTimer = false
          McuEcmErrorMIDelayTimer = false
          McuEcmErrorOutputMask = true
        McuEcmErrorSource20:
          McuNmiNotification = NULL_PTR
          McuMiNotification = NULL_PTR
          McuEcmErrorMaskableInterrupt = false
          McuEcmErrorNonMaskableInterrupt = false
          McuEcmErrorInternalReset = false
          McuEcmErrorNMIDelayTimer = false
          McuEcmErrorMIDelayTimer = false
          McuEcmErrorOutputMask = true
        McuEcmErrorSource21:
          McuNmiNotification = NULL_PTR
          McuMiNotification = NULL_PTR
          McuEcmErrorMaskableInterrupt = false
          McuEcmErrorNonMaskableInterrupt = false
          McuEcmErrorInternalReset = false
          McuEcmErrorNMIDelayTimer = false
          McuEcmErrorMIDelayTimer = false
          McuEcmErrorOutputMask = true
        McuEcmErrorSource22:
          McuNmiNotification = NULL_PTR
          McuMiNotification = NULL_PTR
          McuEcmErrorMaskableInterrupt = false
          McuEcmErrorNonMaskableInterrupt = false
          McuEcmErrorInternalReset = false
          McuEcmErrorNMIDelayTimer = false
          McuEcmErrorMIDelayTimer = false
          McuEcmErrorOutputMask = true
        McuEcmErrorSource23:
          McuNmiNotification = NULL_PTR
          McuMiNotification = NULL_PTR
          McuEcmErrorMaskableInterrupt = false
          McuEcmErrorNonMaskableInterrupt = false
          McuEcmErrorInternalReset = false
          McuEcmErrorNMIDelayTimer = false
          McuEcmErrorMIDelayTimer = false
          McuEcmErrorOutputMask = true
        McuEcmErrorSource24:
          McuNmiNotification = NULL_PTR
          McuMiNotification = NULL_PTR
          McuEcmErrorMaskableInterrupt = false
          McuEcmErrorNonMaskableInterrupt = false
          McuEcmErrorInternalReset = false
          McuEcmErrorNMIDelayTimer = false
          McuEcmErrorMIDelayTimer = false
          McuEcmErrorOutputMask = true
        McuEcmErrorSource26:
          McuNmiNotification = NULL_PTR
          McuMiNotification = NULL_PTR
          McuEcmErrorMaskableInterrupt = false
          McuEcmErrorNonMaskableInterrupt = false
          McuEcmErrorInternalReset = false
          McuEcmErrorNMIDelayTimer = false
          McuEcmErrorMIDelayTimer = false
          McuEcmErrorOutputMask = true
        McuEcmErrorSource27:
          McuNmiNotification = NULL_PTR
          McuMiNotification = NULL_PTR
          McuEcmErrorMaskableInterrupt = false
          McuEcmErrorNonMaskableInterrupt = false
          McuEcmErrorInternalReset = false
          McuEcmErrorNMIDelayTimer = false
          McuEcmErrorMIDelayTimer = false
          McuEcmErrorOutputMask = true
        McuEcmErrorSource28:
          McuNmiNotification = NULL_PTR
          McuMiNotification = NULL_PTR
          McuEcmErrorMaskableInterrupt = false
          McuEcmErrorNonMaskableInterrupt = false
          McuEcmErrorInternalReset = false
          McuEcmErrorNMIDelayTimer = false
          McuEcmErrorMIDelayTimer = false
          McuEcmErrorOutputMask = true
        McuEcmErrorSource29:
          McuNmiNotification = NULL_PTR
          McuMiNotification = NULL_PTR
          McuEcmErrorMaskableInterrupt = false
          McuEcmErrorNonMaskableInterrupt = false
          McuEcmErrorInternalReset = false
          McuEcmErrorNMIDelayTimer = false
          McuEcmErrorMIDelayTimer = false
          McuEcmErrorOutputMask = true
        McuEcmErrorSource30:
          McuNmiNotification = NULL_PTR
          McuMiNotification = NULL_PTR
          McuEcmErrorMaskableInterrupt = false
          McuEcmErrorNonMaskableInterrupt = false
          McuEcmErrorInternalReset = false
          McuEcmErrorNMIDelayTimer = false
          McuEcmErrorMIDelayTimer = false
          McuEcmErrorOutputMask = true
        McuEcmErrorSource31:
          McuNmiNotification = NULL_PTR
          McuMiNotification = NULL_PTR
          McuEcmErrorMaskableInterrupt = false
          McuEcmErrorNonMaskableInterrupt = false
          McuEcmErrorInternalReset = false
          McuEcmErrorNMIDelayTimer = false
          McuEcmErrorMIDelayTimer = false
          McuEcmErrorOutputMask = true
        McuEcmErrorSource32:
          McuNmiNotification = NULL_PTR
          McuMiNotification = NULL_PTR
          McuEcmErrorMaskableInterrupt = false
          McuEcmErrorNonMaskableInterrupt = false
          McuEcmErrorInternalReset = false
          McuEcmErrorNMIDelayTimer = false
          McuEcmErrorMIDelayTimer = false
          McuEcmErrorOutputMask = true
        McuEcmErrorSource33:
          McuNmiNotification = NULL_PTR
          McuMiNotification = NULL_PTR
          McuEcmErrorMaskableInterrupt = false
          McuEcmErrorNonMaskableInterrupt = false
          McuEcmErrorInternalReset = false
          McuEcmErrorNMIDelayTimer = false
          McuEcmErrorMIDelayTimer = false
          McuEcmErrorOutputMask = true
        McuEcmErrorSource34:
          McuNmiNotification = NULL_PTR
          McuMiNotification = NULL_PTR
          McuEcmErrorMaskableInterrupt = false
          McuEcmErrorNonMaskableInterrupt = false
          McuEcmErrorInternalReset = false
          McuEcmErrorNMIDelayTimer = false
          McuEcmErrorMIDelayTimer = false
          McuEcmErrorOutputMask = true
        McuEcmErrorSource36:
          McuNmiNotification = NULL_PTR
          McuMiNotification = NULL_PTR
          McuEcmErrorMaskableInterrupt = false
          McuEcmErrorNonMaskableInterrupt = false
          McuEcmErrorInternalReset = false
          McuEcmErrorNMIDelayTimer = false
          McuEcmErrorMIDelayTimer = false
          McuEcmErrorOutputMask = true
        McuEcmErrorSource37:
          McuNmiNotification = NULL_PTR
          McuMiNotification = NULL_PTR
          McuEcmErrorMaskableInterrupt = false
          McuEcmErrorNonMaskableInterrupt = false
          McuEcmErrorInternalReset = false
          McuEcmErrorNMIDelayTimer = false
          McuEcmErrorMIDelayTimer = false
          McuEcmErrorOutputMask = true
        McuEcmErrorSource38:
          McuNmiNotification = NULL_PTR
          McuMiNotification = NULL_PTR
          McuEcmErrorMaskableInterrupt = false
          McuEcmErrorNonMaskableInterrupt = false
          McuEcmErrorInternalReset = false
          McuEcmErrorNMIDelayTimer = false
          McuEcmErrorMIDelayTimer = false
          McuEcmErrorOutputMask = true
        McuEcmErrorSource39:
          McuNmiNotification = NULL_PTR
          McuMiNotification = NULL_PTR
          McuEcmErrorMaskableInterrupt = false
          McuEcmErrorNonMaskableInterrupt = false
          McuEcmErrorInternalReset = false
          McuEcmErrorNMIDelayTimer = false
          McuEcmErrorMIDelayTimer = false
          McuEcmErrorOutputMask = true
        McuEcmErrorSource40:
          McuNmiNotification = NULL_PTR
          McuMiNotification = NULL_PTR
          McuEcmErrorMaskableInterrupt = false
          McuEcmErrorNonMaskableInterrupt = false
          McuEcmErrorInternalReset = false
          McuEcmErrorNMIDelayTimer = false
          McuEcmErrorMIDelayTimer = false
          McuEcmErrorOutputMask = true
        McuEcmErrorSource41:
          McuNmiNotification = NULL_PTR
          McuMiNotification = NULL_PTR
          McuEcmErrorMaskableInterrupt = false
          McuEcmErrorNonMaskableInterrupt = false
          McuEcmErrorInternalReset = false
          McuEcmErrorNMIDelayTimer = false
          McuEcmErrorMIDelayTimer = false
          McuEcmErrorOutputMask = true
        McuEcmErrorSource42:
          McuNmiNotification = NULL_PTR
          McuMiNotification = NULL_PTR
          McuEcmErrorMaskableInterrupt = false
          McuEcmErrorNonMaskableInterrupt = false
          McuEcmErrorInternalReset = false
          McuEcmErrorNMIDelayTimer = false
          McuEcmErrorMIDelayTimer = false
          McuEcmErrorOutputMask = true
        McuEcmErrorSource5:
          McuNmiNotification = NULL_PTR
          McuMiNotification = NULL_PTR
          McuEcmErrorMaskableInterrupt = false
          McuEcmErrorNonMaskableInterrupt = false
          McuEcmErrorInternalReset = false
          McuEcmErrorNMIDelayTimer = false
          McuEcmErrorMIDelayTimer = false
          McuEcmErrorOutputMask = true
        McuEcmErrorSource6:
          McuNmiNotification = NULL_PTR
          McuMiNotification = NULL_PTR
          McuEcmErrorMaskableInterrupt = false
          McuEcmErrorNonMaskableInterrupt = false
          McuEcmErrorInternalReset = false
          McuEcmErrorNMIDelayTimer = false
          McuEcmErrorMIDelayTimer = false
          McuEcmErrorOutputMask = true
        McuEcmErrorSource7:
          McuNmiNotification = NULL_PTR
          McuMiNotification = NULL_PTR
          McuEcmErrorMaskableInterrupt = false
          McuEcmErrorNonMaskableInterrupt = false
          McuEcmErrorInternalReset = false
          McuEcmErrorNMIDelayTimer = false
          McuEcmErrorMIDelayTimer = false
          McuEcmErrorOutputMask = true
        McuEcmErrorSource8:
          McuNmiNotification = NULL_PTR
          McuMiNotification = NULL_PTR
          McuEcmErrorMaskableInterrupt = false
          McuEcmErrorNonMaskableInterrupt = false
          McuEcmErrorInternalReset = false
          McuEcmErrorNMIDelayTimer = false
          McuEcmErrorMIDelayTimer = false
          McuEcmErrorOutputMask = true
        McuEcmErrorSource9:
          McuNmiNotification = NULL_PTR
          McuMiNotification = NULL_PTR
          McuEcmErrorMaskableInterrupt = false
          McuEcmErrorNonMaskableInterrupt = false
          McuEcmErrorInternalReset = false
          McuEcmErrorNMIDelayTimer = false
          McuEcmErrorMIDelayTimer = false
          McuEcmErrorOutputMask = true
        McuEcmErrorSource129: McuEcmErrorInternalReset=false, McuEcmErrorOutputMask=true
      McuClockSettingConfig: McuClockSettingId=0, McuMainOsciFrequency=16000000, McuCpuMainSysClk=160000000, McuUnitName=CLK_CPU
        McuExternalClkOutSetting:
          McuExternalClk0SourceSel = MCU_NO_OUTPUT
          McuExternalClk0DividerSel = 1
          McuExternalClock0 = 0
          McuExternalClk1SourceSel = MCU_NO_OUTPUT
          McuExternalClk1DividerSel = 1
          McuExternalClock1 = 0
        McuClockReferencePoint: McuClockReferencePointFrequency=0
      McuDemEventParameterRefs: MCU_E_CLOCK_FAILURE=DemEventParameter, MCU_E_WRITE_TIMEOUT_FAILURE=DemEventParameter
      McuModeSettingConf: McuModeType=RUN_MODE, McuMode=0
    McuPublishedInformation
      McuResetReasonConf: McuResetReason=0
      McuRstRsnConfPowOnClr: McuResetReason=0
      McuRstRsnConfPinRst: McuResetReason=1
      McuRstRsnConfSwRst: McuResetReason=2
      McuRstRsnConfWdta: McuResetReason=3
      McuRstRsnConfLockStepCompare: McuResetReason=4
      McuRstRsnConfClkMonUprLimErMosc: McuResetReason=5
      McuRstRsnConfClkMonLwrLimErMosc: McuResetReason=6
      McuRstRsnConfClkMonUprLimErWdt: McuResetReason=7
      McuRstRsnConfClkMonLwrLimErWdt: McuResetReason=8
      McuRstRsnConfClkMonUprLimErPclk: McuResetReason=9
      McuRstRsnConfClkMonLwrLimErPclk: McuResetReason=10
      McuRstRsnConfClkMonUprLimErPe1: McuResetReason=11
      McuRstRsnConfClkMonLwrLimErPe1: McuResetReason=12
      McuRstRsnConfLRamEcc2AddPrty: McuResetReason=13
      McuRstRsnConfInstCacheRamEcc2: McuResetReason=14
      McuRstRsnConfCodeFlsEcc2AddPrty: McuResetReason=15
      McuRstRsnConfDataFlsEcc2: McuResetReason=16
      McuRstRsnConfDtsRamEcc2: McuResetReason=17
      McuRstRsnConfCsihRamEcc2: McuResetReason=18
      McuRstRsnConfCanRamEcc2: McuResetReason=19
      McuRstRsnConfFrRamEcc2: McuResetReason=20
      McuRstRsnConfFlsProgMode: McuResetReason=21
      McuRstRsnConfTestMode: McuResetReason=22
      McuRstRsnConfSingChipModInact: McuResetReason=23
      McuRstRsnConfPeGuard: McuResetReason=24
      McuRstRsnConfPBusGuard: McuResetReason=25
      McuRstRsnConfSarAdcPrty: McuResetReason=26
      McuRstRsnConfBusDataPrty: McuResetReason=27
      McuRstRsnConfEcmCompare: McuResetReason=28
      McuRstRsnConfLvi: McuResetReason=29
      McuRstRsnConfTempSensor: McuResetReason=30
      McuRstRsnConfDmaTrans: McuResetReason=31
      McuRstRsnConfDmaViol: McuResetReason=32
      McuRstRsnConfLRamEcc1: McuResetReason=33
      McuRstRsnConfCodeFlsEcc1: McuResetReason=34
      McuRstRsnConfDataFlsEcc1: McuResetReason=35
      McuRstRsnConfDtsRamEcc1: McuResetReason=36
      McuRstRsnConfPeriRamEcc1: McuResetReason=37
      McuRstRsnConfBistCodeEcc1: McuResetReason=38
      McuRstRsnConfBistCodeEcc2: McuResetReason=39
      McuRstRsnConfFaci: McuResetReason=40
      McuRstRsnConfEcmDelayOverFlow: McuResetReason=41
      McuRstRsnConfCvmRst: McuResetReason=42
      McuRstRsnConfRstUndefined: McuResetReason=43
      McuRstRsnConfRstUnknown: McuResetReason=44
    McuGeneralConfiguration:
      McuVersionCheckExternalModules = true
      McuDevErrorDetect = false
      McuGetRamStateApi = false
      McuInitClock = true
      McuNoPll = true
      McuPerformResetApi = false
      McuVersionInfoApi = false
      McuCriticalSectionProtection = true
      McuSwResetCallApi = false
      McuEcmDelayTimerOverflowValue = 65535
      McuEcmErrorOutputMode = NON_DYNAMIC_MODE
      McuEcmErrorOutTimer = false
      McuRamSectorSetting = false
      McuDeviceName = R7F701311
      McuClm0Operation = false
      McuClm0MonitoringClockAccuracy = 9
      McuClm0SamplingClockAccuracy = 9
      McuClm1Operation = false
      McuClm1MonitoringClockAccuracy = 9
      McuClm1SamplingClockAccuracy = 9
      McuClm2Operation = false
      McuClm2MonitoringClockAccuracy = 14
      McuClm2SamplingClockAccuracy = 14
      McuClm3Operation = false
      McuClm3MonitoringClockAccuracy = 14
      McuClm3SamplingClockAccuracy = 14
      McuCvmSelfDiagnosticTest = false
      McuClma{0..3}SelfDiagnosticTest = false
      McuEcmSelfDiagnosticTest = false
      McuReadBackConfiguration = false
      McuLoopCount = 5
      McuLockStepSelfDiagnosticTest = false
  module config Dem: implementation-config-variant=VARIANT-PRE-COMPILE
    DemConfigSet
      DemEventParameter: DemEventAvailable=false, DemEventId=1, DemEventKind=DEM_EVENT_KIND_BSW
        DemEventClass: DemAgingAllowed=false, DemConsiderPtoStatus=false, DemEventPriority=1, DemFFPrestorageSupported=false, DemOperationCycleRef=DemOperationCycle
          DemDebounceAlgorithmClass
            DemDebounceCounterBased:
              DemDebounceBehavior = DEM_DEBOUNCE_FREEZE
              DemDebounceCounterDecrementStepSize = 1
              DemDebounceCounterFailedThreshold = 1
              DemDebounceCounterIncrementStepSize = 1
              DemDebounceCounterJumpDown = false
              DemDebounceCounterJumpDownValue = 0
              DemDebounceCounterJumpUp = false
              DemDebounceCounterJumpUpValue = 0
              DemDebounceCounterPassedThreshold = -32768
              DemDebounceCounterStorage = false
    DemGeneral:
      DemAgingCycleCounterProcessing = DEM_PROCESS_AGINGCTR_INTERN
      DemAgingRequieresTestedCycle = false
      DemAvailabilitySupport = DEM_NO_AVAILABILITY
      DemBswErrorBufferSize = 0
      DemClearDTCBehavior = DEM_CLRRESP_VOLATILE
      DemClearDTCLimitation = DEM_ALL_SUPPORTED_DTCS
      DemDataElementDefaultEndianness = BIG_ENDIAN
      DemDebounceCounterBasedSupport = false
      DemDebounceTimeBasedSupport = false
      DemDevErrorDetect = false
      DemDtcStatusAvailabilityMask = 0
      DemEnableConditionSupport = false
      DemEventCombinationSupport = DEM_EVCOMB_DISABLED
      DemEventDisplacementStrategy = DEM_DISPLACEMENT_FULL
      DemEventMemoryEntryStorageTrigger = DEM_STORAGE_ON_TEST_FAILED
      DemGeneralInterfaceSupport = false
      DemMaxNumberEventEntryMirror = 0
      DemMaxNumberEventEntryPermanent = 0
      DemMaxNumberEventEntryPrimary = 1
      DemMaxNumberEventEntrySecondary = 0
      DemMaxNumberPrestoredFF = 0
      DemOBDSupport = DEM_OBD_NO_OBD_SUPPORT
      DemOccurrenceCounterProcessing = DEM_PROCESS_OCCCTR_TF
      DemOperationCycleStatusStorage = false
      DemPTOSupport = false
      DemResetConfirmedBitOnOverflow = true
      DemStatusBitHandlingTestFailedSinceLastClear = DEM_STATUS_BIT_NORMAL
      DemStatusBitStorageTestFailed = false
      DemStorageConditionSupport = false
      DemSuppressionSupport = DEM_NO_SUPPRESSION
      DemTaskTime = 0.001
      DemTriggerDcmReports = false
      DemTriggerDltReports = false
      DemTriggerFiMReports = false
      DemTriggerMonitorInitBeforeClearOk = false
      DemTypeOfDTCSupported = DEM_DTC_TRANSLATION_ISO11992_4
      DemTypeOfFreezeFrameRecordNumeration = DEM_FF_RECNUM_CALCULATED
      DemVersionInfoApi = false
      DemOperationCycle: DemOperationCycleAutomaticEnd=false, DemOperationCycleAutostart=false, DemOperationCycleType=DEM_OPCYC_IGNITION
  module config NvM: implementation-config-variant=VARIANT-PRE-COMPILE
    NvMBlockDescriptor:
      NvMBlockJobPriority = 0
      NvMBlockManagementType = NVM_BLOCK_DATASET
      NvMBlockUseCrc = false
      NvMBlockUseSyncMechanism = false
      NvMBlockWriteProt = false
      NvMBswMBlockStatusInformation = false
      NvMMaxNumOfReadRetries = 0
      NvMMaxNumOfWriteRetries = 7
      NvMNvBlockBaseNumber = 1
      NvMNvBlockLength = 1
      NvMNvBlockNum = 1
      NvMNvramBlockIdentifier = 2
      NvMNvramDeviceId = 0
      NvMResistantToChangedSw = false
      NvMRomBlockNum = 0
      NvMStaticBlockIDCheck = false
      NvMWriteBlockOnce = false
      NvMWriteVerification = false
      NvMWriteVerificationDataSize = 1
      NvMTargetBlockReference
        NvMFeeRef: NvMNameOfFeeBlock=FeeBlockDescriptor
    NvMCommon:
      NvMApiConfigClass = NVM_API_CONFIG_CLASS_1
      NvMBswMMultiBlockJobStatusInformation = true
      NvMCompiledConfigId = 0
      NvMCrcNumOfBytes = 1
      NvMDatasetSelectionBits = 0
      NvMDevErrorDetect = false
      NvMDrvModeSwitch = false
      NvMDynamicConfiguration = false
      NvMJobPrioritization = false
      NvMPollingMode = true
      NvMRepeatMirrorOperations = 0
      NvMSetRamBlockStatusApi = false
      NvMSizeStandardJobQueue = 1
      NvMVersionInfoApi = false
