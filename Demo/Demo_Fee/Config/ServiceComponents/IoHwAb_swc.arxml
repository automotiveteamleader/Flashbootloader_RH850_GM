AUTOSAR XML (schema 4-0-3)
package /MICROSAR/IoHwAb_swc/ComponentTypes
  ecu abstraction sw component type IoHwAb
    behavior IoHwAbInternalBehavior: handle-termination-and-restart=NO-SUPPORT
  swc implementation IoHwAbImplementation: programming-language=C, behavior=IoHwAbInternalBehavior
