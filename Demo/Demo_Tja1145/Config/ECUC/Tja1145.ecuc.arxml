AUTOSAR XML (schema 4-2-2)
package /ActiveEcuC
  ecuc value collection ActiveEcuC: ecuc-values=[CanTrcv, EcuC, Spi, EcuM]
  module config CanTrcv: implementation-config-variant=VARIANT-PRE-COMPILE, module-description=CanTrcv_Impl
    CanTrcvConfigSet
      CanTrcvChannel:
        CanTrcvInitState = CANTRCV_OP_MODE_NORMAL
        CanTrcvChannelId = 0
        CanTrcvChannelUsed = true
        CanTrcvControlsPowerSupply = false
        CanTrcvHwPnSupport = true
        CanTrcvMaxBaudrate = 1000
        CanTrcvWakeupByBusUsed = true
        CanTrcvEnablePNMD = true
        CanTrcvFdTolerance = false
        CanTrcvWakeupSourceRef = EcuMWakeupSource
        CanTrcvSyserrWakeupSourceRef = EcuMWakeupSource
        CanTrcvPorWakeupSourceRef = EcuMWakeupSource
        CanTrcvPartialNetwork:
          CanTrcvBusErrFlag = false
          CanTrcvBaudRate = 500
          CanTrcvPnCanIdIsExtended = true
          CanTrcvPnEnabled = true
          CanTrcvPnFrameCanId = 282852864
          CanTrcvPnFrameCanIdMask = 255
          CanTrcvPnFrameDlc = 8
          CanTrcvPowerOnFlag = false
          8 x CanTrcvPnFrameDataMaskSpec, all with CanTrcvPnFrameDataMask=255:
            CanTrcvPnFrameDataMaskSpec: CanTrcvPnFrameDataMaskIndex=0
            CanTrcvPnFrameDataMaskSpec_001: CanTrcvPnFrameDataMaskIndex=1
            CanTrcvPnFrameDataMaskSpec_002: CanTrcvPnFrameDataMaskIndex=2
            CanTrcvPnFrameDataMaskSpec_003: CanTrcvPnFrameDataMaskIndex=3
            CanTrcvPnFrameDataMaskSpec_004: CanTrcvPnFrameDataMaskIndex=4
            CanTrcvPnFrameDataMaskSpec_005: CanTrcvPnFrameDataMaskIndex=5
            CanTrcvPnFrameDataMaskSpec_006: CanTrcvPnFrameDataMaskIndex=6
            CanTrcvPnFrameDataMaskSpec_007: CanTrcvPnFrameDataMaskIndex=7
        CanTrcvAccess
          CanTrcvSpiSequence: CanTrcvSpiAccessSynchronous=true
            3 x CanTrcvSpiSequenceAccess, all with CanTrcvSpiAccessSynchronous=true:
              SeqRWDataNormal: CanTrcvSpiSequenceIdentifier=SeqRWDataNormal, CanTrcvSpiSequenceName=SpiSequence
              SeqRWDataMedium: CanTrcvSpiSequenceIdentifier=SeqRWDataMedium, CanTrcvSpiSequenceName=SpiSequence_001
              SeqRWDataLarge: CanTrcvSpiSequenceIdentifier=SeqRWDataLarge, CanTrcvSpiSequenceName=SpiSequence_002
    CanTrcvGeneral:
      CanTrcvDevErrorDetect = false
      CanTrcvGetVersionInfo = false
      CanTrcvWakeUpSupport = CANTRCV_WAKEUP_BY_POLLING
      CanTrcvIndex = 0
      CanTrcvMainFunctionPeriod = 0.01
  module config EcuC: implementation-config-variant=VARIANT-PRE-COMPILE, module-description=EcuC_Impl
    EcucGeneral:
      DummyFunction = false
      DummyStatement = true
      StructAlignment = Auto
      ArrayAlignment = Auto
      StructInArrayAlignment = Auto
      SizeOfEnum = Size32Bit
      SizeOfROMPointer = Size32Bit
      SizeOfRAMPointer = Size32Bit
      DummyStatementKind = SelfAssignment
      CPUType = CPU32Bit
      SizeOfInt = Size32Bit
      ByteOrder = LITTLE_ENDIAN
      BitOrder = LSB_to_MSB
      AtomicBitAccessInBitfield = false
      AtomicVariableAccess = Atomic32BitAccess
      BitFieldDataType = INT
      EcuCSafeBswChecks = false
      ConditionalGenerating = true
      EcucBswImplementationCodeType = EcuCSourceCode
      EcuCUseStdReturnTypeForRte = false
      BswInitialization
        3 x InitFunction:
          CanTrcv_30_Tja1145_InitMemory: Header=CanTrcv_30_Tja1145.h, InitPhase=INIT_MEMORY, ModuleRef=CanTrcv
          CanTrcv_30_Tja1145_Init: Header=CanTrcv_30_Tja1145.h, InitPhase=INIT_TWO_TRCV, ConfigType=CanTrcv_30_Tja1145_ConfigType, ConfigPtrName=CanTrcv_30_Tja1145_Config_Ptr, ConfigPtrClass=CANTRCV_30_TJA1145_INIT_DATA, ModuleRef=CanTrcv
          EcuM_Init: Header=EcuM.h, InitPhase=NO_INIT, ConfigType=EcuM_PbConfigType, ConfigPtrName=EcuM_Config_Ptr, ConfigPtrClass=ECUM_INIT_DATA, ModuleRef=EcuM
    EcucPduCollection: PduIdTypeEnum=UINT8, PduLengthTypeEnum=UINT8
  module config Spi: implementation-config-variant=VARIANT-PRE-COMPILE
    SpiDriver: SpiMaxChannel=4, SpiMaxJob=4, SpiMaxSequence=3
      SpiChannel: SpiChannelId=0, SpiChannelType=EB, SpiDataWidth=8, SpiEbMaxLength=4, SpiIbNBuffers=4, SpiTransferStart=MSB, SpiDefaultData=255
      SpiExternalDevice:
        SpiBaudrate = 0
        SpiCsIdentifier = 1
        SpiCsPolarity = HIGH
        SpiDataShiftEdge = LEADING
        SpiEnableCs = true
        SpiHwUnit = CSIB0
        SpiShiftClockIdleLevel = HIGH
        SpiTimeClk2Cs = 0
        SpiCsSelection = CS_VIA_PERIPHERAL_ENGINE
      SpiJob: SpiJobId=0, SpiJobPriority=0, SpiHwUnitSynchronous=SYNCHRONOUS, SpiDeviceAssignment=SpiExternalDevice
        SpiChannelList: SpiChannelIndex=0, SpiChannelAssignment=SpiChannel
      SpiSequence: SpiInterruptibleSequence=false, SpiSequenceId=0, SpiJobAssignment=SpiJob
      3 x SpiChannel, all with SpiChannelType=EB, SpiDataWidth=8, SpiEbMaxLength=4, SpiIbNBuffers=4, SpiTransferStart=MSB, SpiDefaultData=255:
        SpiChannel_001: SpiChannelId=1
        SpiChannel_002: SpiChannelId=2
        SpiChannel_003: SpiChannelId=3
      3 x SpiJob, all with SpiJobPriority=0, SpiHwUnitSynchronous=SYNCHRONOUS, SpiDeviceAssignment=SpiExternalDevice:
        SpiJob_001: SpiJobId=1
          SpiChannelList: SpiChannelIndex=0, SpiChannelAssignment=SpiChannel_001
        SpiJob_002: SpiJobId=2
          SpiChannelList: SpiChannelIndex=0, SpiChannelAssignment=SpiChannel_002
        SpiJob_003: SpiJobId=3
          SpiChannelList: SpiChannelIndex=0, SpiChannelAssignment=SpiChannel_003
      SpiSequence_001 (SpiSequence): SpiInterruptibleSequence=false, SpiSequenceId=1, SpiJobAssignment=SpiJob, SpiJobAssignment=SpiJob_001, SpiJobAssignment=SpiJob_002
      SpiSequence_002 (SpiSequence):
        SpiInterruptibleSequence = false
        SpiSequenceId = 2
        SpiJobAssignment = SpiJob
        SpiJobAssignment = SpiJob_{001..003}
    SpiGeneral:
      SpiCancelApi = true
      SpiChannelBuffersAllowed = 0
      SpiDevErrorDetect = false
      SpiHwStatusApi = true
      SpiInterruptibleSeqAllowed = true
      SpiLevelDelivered = 0
      SpiSupportConcurrentSyncTransmit = false
      SpiVersionInfoApi = false
    SpiPublishedInformation: SpiMaxHwUnit=0
  module config EcuM: implementation-config-variant=VARIANT-PRE-COMPILE, module-description=EcuM_Impl
    EcuMConfiguration
      EcuMCommonConfiguration: EcuMDefaultAppMode=(unset), EcuMOSResource=(unset)
        5 x EcuMWakeupSource, all with EcuMValidationTimeout=0, EcuMCheckWakeupTimeout=0, EcuMWakeupSourcePolling=false:
          ECUM_WKSOURCE_POWER: EcuMWakeupSourceId=0
          ECUM_WKSOURCE_RESET: EcuMWakeupSourceId=1
          ECUM_WKSOURCE_INTERNAL_RESET: EcuMWakeupSourceId=2
          ECUM_WKSOURCE_INTERNAL_WDG: EcuMWakeupSourceId=3
          ECUM_WKSOURCE_EXTERNAL_WDG: EcuMWakeupSourceId=4
        EcuMDefaultShutdownTarget: EcuMDefaultState=EcuMStateOff
        EcuMWakeupSource: EcuMWakeupSourceId=5, EcuMWakeupSourcePolling=false
      EcuMFlexConfiguration: EcuMNormalMcuModeRef=(unset)
        3 x EcuMResetMode:
          ECUM_RESET_MCU: EcuMResetModeId=0
          ECUM_RESET_WDG: EcuMResetModeId=1
          ECUM_RESET_IO: EcuMResetModeId=2
        4 x EcuMShutdownCause:
          ECUM_CAUSE_UNKNOWN: EcuMShutdownCauseId=0
          ECUM_CAUSE_ECU_STATE: EcuMShutdownCauseId=1
          ECUM_CAUSE_WDGM: EcuMShutdownCauseId=2
          ECUM_CAUSE_DCM: EcuMShutdownCauseId=3
        ECUM_RESET_WAKEUP (EcuMResetMode): EcuMResetModeId=3
    EcuMGeneral:
      EcuMDevErrorDetect = false
      EcuMIncludeDem = false
      EcuMIncludeDet = false
      EcuMMainFunctionPeriod = 0.01
      EcuMVersionInfoApi = false
      EcuMDeferredBswMNotification = false
      EcuMSlaveCoreHandling = true
      EcuMEnableFixBehavior = false
      EcuMGeneration: EcuMOutOfBoundsWriteSanitizer=false, EcuMOutOfBoundsReadSanitizer=false, EcuMInterfacesForDeactivatedData=false
    EcuMFlexGeneral
