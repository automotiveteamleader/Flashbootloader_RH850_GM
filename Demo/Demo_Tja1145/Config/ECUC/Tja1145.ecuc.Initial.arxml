AUTOSAR XML (schema 4-2-2)
package /InitialEcuC
  ecuc value collection InitialEcuC
