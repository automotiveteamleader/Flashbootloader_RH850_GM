AUTOSAR XML (schema 4-0-3)
package /MICROSAR/CanTrcv_Tja1145
  bsw implementation CanTrcv_Impl: programming-language=C, sw-version=3.05.00, used-code-generator=cMSR, vendor-id=30, ar-release-version=4.00.03, vendor-api-infix=Tja1145
package /MICROSAR/CanTrcv_Tja1145_ib_bswmd/BswModuleDescriptions
  bsw module description CanTrcv: provided-entrys=CanTrcv_30_Tja1145_MainFunction
    bsw internal behavior CanTrcv_Tja11145_Behavior
      exclusive area CANTRCV_30_TJA1145_EXCLUSIVE_AREA_0
      bsw schedulable entity CanTrcv_30_Tja1145_MainFunction: implemented-entry=CanTrcv_30_Tja1145_MainFunction
      bsw timing event CanTrcv_30_Tja1145_MainFunctionTimingEvent0: starts-on-event=CanTrcv_30_Tja1145_MainFunction, period=0.01
  bsw module entry CanTrcv_30_Tja1145_MainFunction: call-type=SCHEDULED, execution-context=TASK
